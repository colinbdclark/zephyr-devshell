## templates/app/west.yml
```yaml
manifest:
    remotes:
        - name: upstream
          url-base: https://github.com/zephyrproject-rtos

    projects:
        - name: zephyr
          remote: upstream
          revision: v4.4.2
          import: true

    self:
        path: app
```
